## apps-ui/Kconfig
```kconfig
menu  "Application UI"

config APPLICATION_UI
    bool "application ui"
    default n

if APPLICATION_UI

config APPLICATION_UI_ASSISTANT
    bool "assistant pages (home / qrcode / settings)"
    default y
    help
      助手页面（主页、扫码配网、设置、闹钟页）与它们的 models/presenters。
      纯功能固件（如 leo-radio 网络电台）可以关掉：这些页面不会被初始化，
      也不需要 cloud / voice_intent 这些模块的头文件。

config ALARM_RING_AUTO_RETURN_MS
    int "Alarm ring UI auto return timeout (ms)"
    default 60000
    help
        Time before alarm ring page automatically returns to Home.

config TTS_TEXT_MS_PER_CHAR
    int "TTS text display time per character (ms)"
    default 250
    help
        Display duration per spoken character for TTS subtitle text.
        Can be overridden at runtime via KV key user.tts_text_ms_per_char.

endif

endmenu
```

## apps/arcs-mini/arcade/Kconfig
```kconfig
menu "Retro Arcade"

config APPLICATION_ARCADE
    bool "Retro game emulator (GB/GBC/NES)"
    default n
    help
      Build the retro game emulator application.  When enabled, main.c hands
      control to the arcade UI instead of the voice assistant.

if APPLICATION_ARCADE

config ARCADE_APP_EATONLY
    bool "Single-app firmware: only keep the eat-what slot machine"
    default n
    help
      Build a single-application firmware: the device boots straight into the
      built-in "eat what today" slot machine (arcade_eat.c) and nothing else.

      With this enabled the GB/GBC emulator (binjgb / Peanut-GB), the ROM
      scanner, the save-RAM writer and the other built-in mini games (dino,
      jump) are not compiled into the image.  The full-feature build is
      unaffected: leave this off and everything stays available.

      Interaction in this mode:
        - hold the key  -> the next picture group rolls (groups alternate
                           strictly: 1st hold = group 1, 2nd = group 2, ...)
        - release       -> freeze on the current frame (that is the result)
        - any hold time -> never exits and never powers off

config ARCADE_ROM_DIR
    string "ROM directory on the SD card"
    default "/SD:/roms"
    help
      Preferred directory for ROM files.  The VFS directory walk on this
      board is not reliable (lsfs_readdir can wedge on the card root and
      freeze the whole device), so arcade_rom.c does not scan directories:
      it probes a fixed candidate list instead, looking in /SD:/roms/ and
      then /SD:/ for a small set of names (pock.gbc, game.gb, ...).
      This option is only used by the `arcade fs` self-test and the status
      line.

config ARCADE_ROM_MAX
    int "Maximum number of ROMs listed"
    range 4 128
    default 32

choice ARCADE_GB_CORE
    prompt "GB/GBC emulator core"
    default ARCADE_GB_CORE_BINJGB
    help
      Peanut-GB is a single-header DMG-only core: it has no CGB support at all
      (no SVBK / VBK / HDMA), so GBC titles such as Pokemon Crystal animate the
      intro and then hang forever inside DelayFrame() once they touch CGB banks.
      binjgb is pure C99, MIT licensed, and implements the full CGB feature set
      (VRAM/WRAM banking, CGB palettes, GDMA/HDMA, double speed).

config ARCADE_GB_CORE_BINJGB
    bool "binjgb (full GB + GBC)"

config ARCADE_GB_CORE_PEANUT
    bool "Peanut-GB (DMG only, smaller)"

endchoice

config ARCADE_GB_STATE_IN_SRAM
    bool "Keep VRAM/WRAM (16KB) in internal SRAM"
    default n
    help
      binjgb keeps its whole Emulator (~130KB) in PSRAM.  VRAM and WRAM (8KB
      each) are the two hottest arrays in it; with the 32KB D-Cache being
      flushed by the 92KB frame buffer writes and ROM fetches, nearly every
      access misses (~300 cycles per emulated instruction measured).
      Putting those two arrays in internal SRAM avoids that, but the SoC only
      has 168KB of SRAM and it is already nearly full, so this needs the
      WiFi/BLE drivers compiled out (see arcade-sram.conf).

config ARCADE_FRAME_PERIOD_MS
    int "Emulator frame period in milliseconds"
    range 8 100
    default 16
    help
      16 ms targets ~60 fps, 20 ms targets ~50 fps.  Raise it when the
      emulator cannot keep up and frames start to pile up.

config ARCADE_CART_RAM_MAX
    int "Cartridge save RAM size (bytes)"
    default 32768
    help
      Upper bound of the cartridge RAM buffer allocated for the loaded ROM.
      The ROM itself is loaded into PSRAM as a whole when it fits (no SD card
      access during emulation); it only falls back to streaming 16 KB banks
      from the card when PSRAM is too tight.

config ARCADE_LOG_FPS
    bool "Log emulator fps to the shell"
    default y

endif

endmenu
```

## apps/arcs-mini/intercom/Kconfig
```kconfig
config INTERCOM
    bool "对讲机（BLE NUS + 文本对话）"
    default n
    depends on LISA_BLUETOOTH
    depends on LISA_BLUETOOTH_BLE
    depends on APPLICATION_UI
    help
      在固件内实现对讲机：注册 Nordic UART Service（128-bit UUID）作为 BLE 外设，
      按 A5 5A 帧协议与手机端的对讲机 App 通信（文本上下行 + turn 控制）。

      本期能力：握手 hello/status、文本气泡上屏、按住说话（turn_start/cancel/end）、
      网关状态与音量控制。上行语音（Opus）与下行 TTS 未实现，hello 的 caps 如实
      不带 opus / tts_opus。

      与既有能力的关系：复用 SDK 的 BLE 栈与广播（配网小程序不受影响）；本模块只在
      扫描响应里追加 128-bit 服务 UUID 与 LING-xxxx 名字。
```

## apps/arcs-mini/music/Kconfig
```kconfig
config NETEASE_MUSIC
    bool "网易云音乐直连（EAPI + 播放页/歌单/歌词/扫码登录）"
    default n
    depends on APP_PLAYER
    depends on CJSON
    depends on MBEDTLS
    depends on APPLICATION_UI
    # 扫码登录页用 LVGL 的 qrcode 组件渲染动态二维码
    select LV_USE_QRCODE
    help
      把网易云音乐的开源客户端协议（EAPI）做进固件：搜索、歌单详情、歌曲详情、
      播放直链、同步歌词、扫码登录，并用 app_player 的 music 实例真正出声。
      界面是一个独立导航页（id 93），五个子页：播放 / 导航（歌单）/ 歌曲列表 /
      歌词 / 扫码登录。

      协议要点：
        - 请求走 http://music.163.com/eapi/...（实测明文 HTTP 可用，返回的
          音频直链和封面图也都是 http 明文），因此不需要 TLS；
        - 请求体是 AES-128-ECB 加密后的 params 表单，必须带
          Content-Type: application/x-www-form-urlencoded，否则网关返回空 body；
        - 匿名可用，VIP/付费曲目返回 code=-110（url 为 null），按不可播放处理；
        - 扫码登录成功后的 MUSIC_U cookie 明文存 KV（后续 EAPI 请求带 Cookie 头）。
          注意：整条链路是明文 HTTP，登录态在网络上不加密，只适合自用固件。
```

## apps/arcs-mini/radio/Kconfig
```kconfig
config RADIO
    bool "网络电台（城市台单 + 直播流）"
    default n
    depends on APPLICATION_UI
    depends on APP_PLAYER
    depends on CJSON
    help
      在固件内实现一台"网络收音机"：独立页面（导航 id 92）+ 独占一个
      app_player 实例（焦点通道 "radio"）播放 http(s) MP3 直播流。

      台单来源：ip-api.com 定位城市 → radio-browser.info 按城市查台；
      定位或查询失败时回退到内置的 6 个全国性直播台。台单、城市、音量都持久化到 KV。

      入口：电源键四击。页内单击换台、双击播放/暂停、长按进设置菜单、
      三击/四击退出；五/六/七击退出电台并进入 BLE 配网。

      配网不新增任何流程：沿用既有的 BLE 配网（五/六/七击），电台页只负责在无网时
      提示，用户按提示即可完成配网。

config RADIO_AUTO_START
    bool "开机直接进入电台页"
    default y
    depends on RADIO
    help
      开机后自动进入电台播放页并开始播放，把这个固件当"网络收音机"用。

      只有当设备已经保存过 WiFi（sys_wifi_has_ap() 为真）时才自动进入；
      从未配过网的设备保持原行为停在助手主页，否则用户看不到配网/扫码绑定引导，
      也进不了 BLE 配网。

      电台页在前台时仍可用"五/六/七击"退出电台并进入 BLE 配网。
```

## arcs-sdk/drivers/lisa_camera/Kconfig
```kconfig
# Copyright (c) 2025, LISTENAI
# SPDX-License-Identifier: Apache-2.0

menu "LISA Camera"
	config LISA_CAMERA_DEVICE
		bool "LISA Camera support"
		help
			Enable LISA Camera support

if LISA_CAMERA_DEVICE

config LISA_CAMERA_CPDMA_TRANSFORM
    bool "CPDMA RGB565 camera transform"
    depends on SOC_ARCS
    help
      Enable synchronous integer downsampling, 90-degree clockwise rotation
      and byte swapping with CPDMA. Temporarily reserves the configured channel.

config LISA_CAMERA_CPDMA_CH
    int "Camera transform CPDMA channel"
    depends on LISA_CAMERA_CPDMA_TRANSFORM
    range 0 3
    default 1
    help
      Select a channel owned by this core. Reservation state is local to each
      core and cannot detect channels reserved by the other core.


choice LISA_CAMERA_BUS_TYPE
	prompt "Select bus type"
	default LISA_CAMERA_BUS_SPI

	config LISA_CAMERA_BUS_SPI
		bool "SPI Bus"
		select LISA_SPI_DEVICE
		help
			Use SPI bus for camera data.

	config LISA_CAMERA_BUS_DVP
		bool "DVP Bus"
		select LISA_DVP_DEVICE
		help
			Use DVP bus for camera data.

endchoice

config LISA_CAMERA_SENSOR_BF3901
	bool "BF3901"

config LISA_CAMERA_SENSOR_GC032A
	bool "GC032A"

config LISA_CAMERA_SENSOR_GC0328
	bool "GC0328"

config LISA_CAMERA_SENSOR_SC030IOT
	bool "SC030IOT"

config LISA_CAMERA_SENSOR_TC6036
	bool "TC6036"
	help
		Enable TC6036 camera sensor support (640x480 YUV422/RGB565)

endif #LISA_CAMERA_DEVICE

endmenu
```

## arcs-sdk/drivers/lisa_display/panels/Kconfig.st7789p3
```kconfig
# Copyright (c) 2025, LISTENAI
# SPDX-License-Identifier: Apache-2.0

menu "ST7789P3 Display Panel"

if LISA_DISPLAY_PANEL_ST7789P3

config PANEL_ST7789P3_WIDTH
	int "screen width"
	default 170
	help
	The pixel length in the x-axis direction of the display screen, the maximum value is 240.

config PANEL_ST7789P3_HEIGHT
	int "screen height"
	default 320
	help
	The pixel length in the y-axis direction of the display screen, the maximum value is 240.

config PANEL_ST7789P3_GRAM_HEIGHT
	int "controller gram height"
	default 320
	help
	Full frame memory rows of the controller (ST7789 is 240x320). The glass
	only covers PANEL_ST7789P3_HEIGHT rows of them, so when MADCTL MY mirrors
	the row address inside the whole gram, the window start row has to be
	shifted by (gram height - screen height).

config PANEL_ST7789P3_X_OFFSET
	int "display screen x offset"
	default 35
	help
	The pixel offset in the x-axis direction of the display screen.

config PANEL_ST7789P3_Y_OFFSET
	int "screen y offset"
	default 0
	help
	The pixel offset in the y-axis direction of the display screen.

config ROTATE_BUF_MAX_HEIGHT
	int "roate buffer buffer max height"
	default PANEL_ST7789P3_WIDTH

endif

endmenu
```
